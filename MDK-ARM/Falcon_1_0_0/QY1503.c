#include "QY1503.h"

const unsigned char TAD2141CRC[256] =
{
		0x00, 0x1D, 0x3A, 0x27, 0x74, 0x69, 0x4E, 0x53, 0xE8, 0xF5, 0xD2, 0xCF, 0x9C, 0x81, 0xA6, 0xBB,
		0xCD, 0xD0, 0xF7, 0xEA, 0xB9, 0xA4, 0x83, 0x9E, 0x25, 0x38, 0x1F, 0x02, 0x51, 0x4C, 0x6B, 0x76,
		0x87, 0x9A, 0xBD, 0xA0, 0xF3, 0xEE, 0xC9, 0xD4, 0x6F, 0x72, 0x55, 0x48, 0x1B, 0x06, 0x21, 0x3C,
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		0x7F, 0x62, 0x45, 0x58, 0x0B, 0x16, 0x31, 0x2C, 0x97, 0x8A, 0xAD, 0xB0, 0xE3, 0xFE, 0xD9, 0xC4
};

unsigned char PUDI_CRC8(unsigned char *message, unsigned char Bytelength, const unsigned char *TableCRC)
{
	unsigned char crc;
	int Byteidx;

	crc = 0xFF;
	for (Byteidx = 0; Byteidx < Bytelength; Byteidx++)
	{
		crc = TableCRC[crc ^ *(message + Byteidx)];
	}
	return (~crc);
}

uint8_t QY1503_CRC8(uint8_t *data, uint8_t length)
{
	uint8_t i, j;

	uint8_t crc = 0xff;
	uint8_t ploy = 0x1d; /* ??? */

	for (i = 0; i < length; i++)
	{
		crc ^= data[i];
		for (j = 0; j < 8; j++)
		{
			if (crc & 0x80)
			{
				crc = (crc << 1) ^ ploy;
			}
			else
			{
				crc <<= 1;
			}
		}
	}
	crc ^= 0xff;
	return crc;
}

void QY1503_SPI_EndTransaction(void)
{
	HAL_GPIO_WritePin(GPIOA,GPIO_PIN_4,GPIO_PIN_SET);
}

/**
 * @brief  QY1503 SPI?????(??????)
 */
void QY1503_SPI_BeginTransaction(void)
{
	HAL_GPIO_WritePin(GPIOA,GPIO_PIN_4,GPIO_PIN_RESET);
}


uint8_t txbuff[1] =	{0x05};

bool QY1503_ReadRawData(qy1503_raw_data_t *raw_data)
{
	uint8_t crc = 0;
	uint8_t buf[4] = {0};
	uint8_t i;
	bool res;
	uint8_t retry = 0;

	QY1503_SPI_BeginTransaction();
	HAL_SPI_Transmit(&hspi1, txbuff, 1, 100);
	HAL_SPI_Receive(&hspi1, buf, 4, 100);
	crc = QY1503_CRC8(buf, 3);
	if (crc == buf[3])
	{
		raw_data->angle.buf[0] = buf[1];
		raw_data->angle.buf[1] = buf[0];
		raw_data->status = buf[2];
		raw_data->crc = buf[3];
		res = true;
	}
	else
	{
		res = false;
	}

	QY1503_SPI_EndTransaction();
	return res;
}


float QY1503_ReadAngle(void)
{
	float angle = 0.f;
	int32_t prv_raw_angle = 0, raw_angle = 0;
	uint8_t retry = 10; /* ?????? */
	int count_flag = 0;
	bool res = false;
	static uint16_t counter = 0;

	qy1503_raw_data_t raw_data; //??angle?status?crc???

	QY1503_ReadRawData(&raw_data);
	raw_angle = raw_data.angle.val;

	while (retry--)
	{
		QY1503_ReadRawData(&raw_data);

		res = QY1503_ReadRawData(&raw_data);
		if (res == false)
		{
			continue; //CRC????,????
		}
		raw_angle = raw_data.angle.val;
		count_flag = raw_angle - prv_raw_angle;
		if (QY1503_ABS(raw_angle - prv_raw_angle) > QY1503_HYSTLSB) //?????? ??5bit LSB,??????
		{
			prv_raw_angle = raw_angle;
		}

		if (count_flag > 16384) //???????0~65536 ?? 65536~0 ????90° ????
		{
			counter++;
		}
		else if (-count_flag > 16384)
		{
			counter--;
		}
		angle = (double)raw_angle / 65536.0 * 360.0;
	}

	return angle;
}

